## boards/arm/waltherneo/Kconfig
```kconfig
# WaltherNeo board configuration

# Copyright (c) 2016 Nordic Semiconductor ASA
# SPDX-License-Identifier: Apache-2.0

config GPIO_AS_PINRESET
	bool "GPIO as pin reset (reset button)"
	default y
	depends on BOARD_WALTHERNEOV2 || BOARD_WALTHERNEOV3
```

## boards/arm/waltherneo/Kconfig.board
```kconfig
# nRF52840 DK NRF52840 board configuration

# Copyright (c) 2016 Nordic Semiconductor ASA
# SPDX-License-Identifier: Apache-2.0

config BOARD_WALTHERNEOV2
	bool "WaltherNeo NRF52832"
	depends on SOC_NRF52832_QFAA
	
config BOARD_WALTHERNEOV3
	bool "WaltherNeo NRF52832"
	depends on SOC_NRF52832_QFAA
```

## boards/arm/waltherneo/Kconfig.defconfig
```kconfig
# WaltherNeo board configuration

# Copyright (c) 2016 Nordic Semiconductor ASA
# SPDX-License-Identifier: Apache-2.0

if BOARD_WALTHERNEOV2 || BOARD_WALTHERNEOV3

config BOARD
	default "waltherneov2" if BOARD_WALTHERNEOV2
	default "waltherneov3" if BOARD_WALTHERNEOV3

endif # BOARD_WALTHERNEOV2 V3
```

## boards/arm/waltherneo/waltherneov3_defconfig
```kconfig
# SPDX-License-Identifier: Apache-2.0

CONFIG_SOC_SERIES_NRF52X=y
CONFIG_SOC_NRF52832_QFAA=y
CONFIG_BOARD_WALTHERNEOV3=y

#no low freq. crystal
CONFIG_CLOCK_CONTROL_NRF_K32SRC_RC=y
CONFIG_CLOCK_CONTROL_NRF_K32SRC_250PPM=y

# Enable MPU
CONFIG_ARM_MPU=y

# enable GPIO
CONFIG_GPIO=y

# enable uart driver
CONFIG_SERIAL=y

# enable console
CONFIG_CONSOLE=y
CONFIG_UART_CONSOLE=y

# additional board options
CONFIG_GPIO_AS_PINRESET=y

# bluetooth
CONFIG_BT=y
CONFIG_BT_CTLR=y
```

## boards/arm/waltherneov3/Kconfig.board
```kconfig
# nRF52840 DK NRF52840 board configuration

# Copyright (c) 2016 Nordic Semiconductor ASA
# SPDX-License-Identifier: Apache-2.0

config BOARD_WALTHERNEOV3
	bool "WaltherNeov3 NRF52832"
	depends on SOC_NRF52832_QFAA
```

## boards/arm/waltherneov3/Kconfig.defconfig
```kconfig
# WaltherNeov3 board configuration

# Copyright (c) 2016 Nordic Semiconductor ASA
# SPDX-License-Identifier: Apache-2.0

if BOARD_WALTHERNEOV3

config BOARD
	default "waltherneov3"

endif # BOARD_WALTHERNEOV3
```

## boards/arm/waltherneov4/Kconfig.defconfig
```kconfig
# WaltherNeov4 board configuration

# Copyright (c) 2016 Nordic Semiconductor ASA
# SPDX-License-Identifier: Apache-2.0

if BOARD_WALTHERNEOV4

config BOARD
	default "waltherneov4"

endif # BOARD_WALTHERNEOV4
```
